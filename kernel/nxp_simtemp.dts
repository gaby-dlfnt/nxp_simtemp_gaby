// SPDX-License-Identifier: GPL-2.0
/*
 * NXP SimTemp - Simulated Temperature Sensor
 */

/dts-v1/;

/ {
    model = "NXP SimTemp Test Board";
    compatible = "nxp,simtemp-test";
    
    #address-cells = <1>;
    #size-cells = <0>;
    
    /* Proper node with address cells defined */
    simtemp@0 {
        compatible = "nxp,simtemp";
        reg = <0>;
        
        /* Device tree parameters */
        sampling-period-ms = <200>;
        temperature-threshold-mc = <40000>;
        default-mode = "noisy";
        
        status = "okay";
    };
};